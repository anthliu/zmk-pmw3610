/*
 * Copyright (c) 2020 ZMK Contributors
 *
 * SPDX-License-Identifier: MIT
 */
 
#include "rat.dtsi"

// trackball bus
&spi0 {
	status = "okay"; //okay
	sck-pin = <3>;
	mosi-pin = <28>;
	miso-pin = <28>; // same as mosi (3-wire spi)
	cs-gpios = <&xiao_d 3 GPIO_ACTIVE_LOW>;
};

&trackball {
	status = "okay"; //okay
	irq-gpios = <&xiao_d 0 (GPIO_ACTIVE_LOW | GPIO_PULL_UP)>;
};

&scroll_encoder {
        status = "okay";
};
